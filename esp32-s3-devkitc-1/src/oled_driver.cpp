/*
 * oled_driver.cpp - OLED (SSD1306) I2C驱动, 14表情 + phanion全屏 + 眨眼 + 边框文字
 */
#include "oled_driver.h"
#include <Wire.h>
#include <SPI.h>
#include "emoji_bitmaps.h"

static U8G2_SSD1306_128X64_NONAME_F_HW_I2C u8g2_oled(U8G2_R0, U8X8_PIN_NONE);

// 共用轮廓: 16x16圆形, outline在bit6/byte0和bit1/byte1
// 眼睛区rows5-6, 嘴巴区rows9-10, 每个2bytes

// 0: FACE_PIANO_1 - 按键1 (phanion全屏独立处理, 此处占位)
static const uint8_t PROGMEM face_0[] = {
  0x03,0xC0, 0x0C,0x30, 0x10,0x08, 0x20,0x04, 0x40,0x02,
  0x40,0x62, 0x40,0x62, 0x40,0x02, 0x40,0x02,
  0x44,0x22, 0x43,0xC2, 0x40,0x02, 0x20,0x04, 0x10,0x08, 0x0C,0x30, 0x03,0xC0
};

// phanion角色 全屏图像 (128x64 XBM)
static const uint8_t PROGMEM image_phanion[] = {
  0xff,0xff,0xff,0xff,0xff,0xff,0xff,0xff,0xff,0xff,0xff,0xff,0xff,0xff,0xff,0xff,
  0xff,0xff,0xff,0xff,0xff,0xff,0xff,0xff,0xff,0xff,0xff,0xff,0xff,0xff,0xff,0xff,
  0xff,0xff,0xff,0xff,0xff,0xff,0xff,0xff,0xff,0xff,0xff,0xff,0xff,0xff,0xff,0xff,
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  0xff,0xff,0xff,0xff,0xff,0xff,0xff,0xff,0xff,0xff,0xe0,0x2f,0xff,0xff,0xff,0xff,
};

// phanion2 (128x64 XBM)
static const uint8_t PROGMEM image_phanion2[] = {
  0xff,0xff,0xff,0xff,0xff,0xff,0xff,0xff,0xff,0xff,0xff,0xff,0xff,0xff,0xff,0xff,
  0xff,0xff,0xff,0xff,0xff,0xff,0xff,0xff,0xff,0xff,0xff,0xff,0xff,0xff,0xff,0xff,
  0xff,0xff,0xff,0xff,0xff,0xff,0xff,0xff,0xff,0xff,0xff,0xff,0xff,0xff,0xff,0xff,
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  0xff,0xff,0xff,0xff,0xff,0xff,0xff,0xff,0xff,0xff,0xff,0xff,0xff,0xff,0xff,0xff,
};

// phanion3 (128x64 XBM)
static const uint8_t PROGMEM image_phanion3[] = {
  0xff,0xff,0xff,0xff,0xff,0xff,0xff,0xff,0xff,0xff,0xff,0xff,0xff,0xff,0xff,0xff,
  0xff,0xff,0xff,0xff,0xff,0xff,0xff,0xff,0xff,0xff,0xff,0xff,0xff,0xff,0xff,0xff,
  0xff,0xff,0xff,0xff,0xff,0xff,0xff,0xff,0xff,0xff,0xff,0xff,0xff,0xff,0xff,0xff,
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  0xff,0xff,0xff,0xff,0xff,0xff,0xff,0xff,0xff,0xff,0xff,0xff,0xff,0xff,0xff,0xff,
};

// mydei1 (128x64 XBM)
static const uint8_t PROGMEM image_mydei1[] = {
  0xff,0xff,0xff,0xff,0xff,0xff,0xff,0xff,0xff,0xff,0xff,0xff,0xff,0xff,0xff,0xff,
  0xff,0xff,0xff,0xff,0xff,0xff,0xff,0xff,0xff,0xff,0xff,0xff,0xff,0xff,0xff,0xff,
  0xff,0xff,0xff,0xff,0xff,0xff,0xff,0xff,0xff,0xff,0xff,0xff,0xff,0xff,0xff,0xff,
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  0xff,0xff,0xff,0xff,0xff,0xff,0xff,0xff,0xff,0xff,0xf0,0x0f,0xff,0xff,0xff,0xff,
};

// mydei2 (128x64 XBM)
static const uint8_t PROGMEM image_mydei2[] = {
  0xff,0xff,0xff,0xff,0xff,0xff,0xff,0xff,0xff,0xff,0xff,0xff,0xff,0xff,0xff,0xff,
  0xff,0xff,0xff,0xff,0xff,0xff,0xff,0xff,0xff,0xff,0xff,0xff,0xff,0xff,0xff,0xff,
  0xff,0xff,0xff,0xff,0xff,0xff,0xf8,0x7f,0xff,0xff,0xff,0xff,0xff,0xff,0xff,0xff,
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  0xff,0xff,0xff,0xff,0xff,0xff,0xff,0xff,0xff,0xff,0xff,0xff,0xff,0xff,0xff,0xff,
};

// mydei3 (128x64 XBM)
static const uint8_t PROGMEM image_mydei3[] = {
  0xff,0xff,0xff,0xff,0xff,0xff,0xff,0xff,0xff,0xff,0xff,0xff,0xff,0xff,0xff,0xff,
  0xff,0xff,0xff,0xff,0xff,0xff,0xff,0xff,0xff,0xff,0xff,0xff,0xff,0xff,0xff,0xff,
  0xff,0xff,0xff,0xff,0xff,0xff,0xff,0xff,0xff,0xff,0xff,0xff,0xff,0xff,0xff,0xff,
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  0xff,0xff,0xff,0xff,0xff,0xff,0xff,0xff,0xff,0xff,0xff,0xff,0xff,0xff,0xff,0xff,
};

// conflict: 左右键同时按下时的融合角色 (128x64)
static const uint8_t PROGMEM image_conflict[] = {
  0x00,0x00,0x00,0x00,0x00,0x00,0x00,0x03,0xE0,0x00,0x00,0x00,0x00,0x00,0x00,0x00,
  0x00,0x00,0x00,0x00,0x00,0x00,0x00,0x03,0xE0,0x00,0x00,0x00,0x00,0x00,0x00,0x00,
  0x00,0x00,0x00,0x00,0x00,0x00,0x00,0x03,0xE0,0x00,0x00,0x00,0x00,0x00,0x00,0x00,
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  0x00,0x00,0x00,0x00,0x00,0x00,0x00,0x00,0x00,0x00,0x00,0x00,0x00,0x00,0x00,0x00
};

// 1: FACE_PIANO_2 - 眨眼(右眼闭)
static const uint8_t PROGMEM face_1[] = {
  0x03,0xC0, 0x0C,0x30, 0x10,0x08, 0x20,0x04, 0x40,0x02,
  0x46,0x02, 0x46,0x02, 0x40,0x02, 0x40,0x02,
  0x44,0x22, 0x43,0xC2, 0x40,0x02, 0x20,0x04, 0x10,0x08, 0x0C,0x30, 0x03,0xC0
};

// 2: FACE_PIANO_4 - 惊讶(圆眼大)
static const uint8_t PROGMEM face_2[] = {
  0x03,0xC0, 0x0C,0x30, 0x10,0x08, 0x20,0x04, 0x40,0x02,
  0x47,0xE2, 0x47,0xE2, 0x40,0x02, 0x40,0x02,
  0x4E,0x72, 0x4E,0x72, 0x40,0x02, 0x20,0x04, 0x10,0x08, 0x0C,0x30, 0x03,0xC0
};

// 3: FACE_PIANO_5 - 酷(墨镜横条)
static const uint8_t PROGMEM face_3[] = {
  0x03,0xC0, 0x0C,0x30, 0x10,0x08, 0x20,0x04, 0x40,0x02,
  0x7F,0xFE, 0x7F,0xFE, 0x40,0x02, 0x40,0x02,
  0x44,0x22, 0x43,0xC2, 0x40,0x02, 0x20,0x04, 0x10,0x08, 0x0C,0x30, 0x03,0xC0
};

// 4: FACE_PIANO_COMBO - 开心(^^)
static const uint8_t PROGMEM face_4[] = {
  0x03,0xC0, 0x0C,0x30, 0x10,0x08, 0x20,0x04, 0x40,0x02,
  0x46,0x62, 0x46,0x62, 0x40,0x02, 0x40,0x02,
  0x46,0x62, 0x43,0xC2, 0x40,0x02, 0x20,0x04, 0x10,0x08, 0x0C,0x30, 0x03,0xC0
};

// 5: FACE_PIANO_MISS - 失误(X眼)
static const uint8_t PROGMEM face_5[] = {
  0x03,0xC0, 0x0C,0x30, 0x10,0x08, 0x20,0x04, 0x40,0x02,
  0x45,0x52, 0x42,0x22, 0x40,0x02, 0x40,0x02,
  0x41,0x82, 0x42,0x42, 0x40,0x02, 0x20,0x04, 0x10,0x08, 0x0C,0x30, 0x03,0xC0
};

// 6: FACE_STUDY_A - 专注(睁眼)
static const uint8_t PROGMEM face_6[] = {
  0x03,0xC0, 0x0C,0x30, 0x10,0x08, 0x20,0x04, 0x40,0x02,
  0x46,0x62, 0x46,0x62, 0x40,0x02, 0x40,0x02,
  0x40,0x02, 0x47,0xE2, 0x40,0x02, 0x20,0x04, 0x10,0x08, 0x0C,0x30, 0x03,0xC0
};

// 7: FACE_STUDY_B - 专注(闭眼,眨眼对)
static const uint8_t PROGMEM face_7[] = {
  0x03,0xC0, 0x0C,0x30, 0x10,0x08, 0x20,0x04, 0x40,0x02,
  0x40,0x02, 0x43,0xC2, 0x40,0x02, 0x40,0x02,
  0x40,0x02, 0x47,0xE2, 0x40,0x02, 0x20,0x04, 0x10,0x08, 0x0C,0x30, 0x03,0xC0
};

// 8: FACE_PAUSE_A - 暂停(睁眼+小嘴)
static const uint8_t PROGMEM face_8[] = {
  0x03,0xC0, 0x0C,0x30, 0x10,0x08, 0x20,0x04, 0x40,0x02,
  0x46,0x62, 0x46,0x62, 0x40,0x02, 0x40,0x02,
  0x40,0x02, 0x46,0x62, 0x40,0x02, 0x20,0x04, 0x10,0x08, 0x0C,0x30, 0x03,0xC0
};

// 9: FACE_PAUSE_B - 暂停(闭眼+小嘴)
static const uint8_t PROGMEM face_9[] = {
  0x03,0xC0, 0x0C,0x30, 0x10,0x08, 0x20,0x04, 0x40,0x02,
  0x40,0x02, 0x43,0xC2, 0x40,0x02, 0x40,0x02,
  0x40,0x02, 0x46,0x62, 0x40,0x02, 0x20,0x04, 0x10,0x08, 0x0C,0x30, 0x03,0xC0
};

// 10: FACE_DONE_A - 完成(睁眼大笑)
static const uint8_t PROGMEM face_10[] = {
  0x03,0xC0, 0x0C,0x30, 0x10,0x08, 0x20,0x04, 0x40,0x02,
  0x47,0xE2, 0x47,0xE2, 0x40,0x02, 0x40,0x02,
  0x46,0x62, 0x43,0xC2, 0x40,0x02, 0x20,0x04, 0x10,0x08, 0x0C,0x30, 0x03,0xC0
};

// 11: FACE_DONE_B - 完成(闭眼大笑)
static const uint8_t PROGMEM face_11[] = {
  0x03,0xC0, 0x0C,0x30, 0x10,0x08, 0x20,0x04, 0x40,0x02,
  0x40,0x02, 0x43,0xC2, 0x40,0x02, 0x40,0x02,
  0x46,0x62, 0x43,0xC2, 0x40,0x02, 0x20,0x04, 0x10,0x08, 0x0C,0x30, 0x03,0xC0
};

// 12: FACE_IDLE_A - 待机(睁眼+小嘴)
static const uint8_t PROGMEM face_12[] = {
  0x03,0xC0, 0x0C,0x30, 0x10,0x08, 0x20,0x04, 0x40,0x02,
  0x46,0x62, 0x46,0x62, 0x40,0x02, 0x40,0x02,
  0x40,0x02, 0x43,0xC2, 0x40,0x02, 0x20,0x04, 0x10,0x08, 0x0C,0x30, 0x03,0xC0
};

// 13: FACE_IDLE_B - 待机(闭眼+小嘴)
static const uint8_t PROGMEM face_13[] = {
  0x03,0xC0, 0x0C,0x30, 0x10,0x08, 0x20,0x04, 0x40,0x02,
  0x40,0x02, 0x43,0xC2, 0x40,0x02, 0x40,0x02,
  0x40,0x02, 0x43,0xC2, 0x40,0x02, 0x20,0x04, 0x10,0x08, 0x0C,0x30, 0x03,0xC0
};

static const uint8_t* const faceBitmaps[FACE_COUNT] = {
  face_0, face_1, face_2,  face_3,  face_4,  face_5,  face_6,
  face_7, face_8, face_9,  face_10, face_11, face_12, face_13
};

// 边框文字缓存
static char borderTop[16] = "";
static char borderBottom[16] = "";

// ========== 公共接口 ==========

void initOLED() {
  Wire.begin(OLED_SDA_PIN, OLED_SCL_PIN);
  u8g2_oled.begin();
  u8g2_oled.enableUTF8Print();
  u8g2_oled.setFont(u8g2_font_wqy12_t_gb2312);
  u8g2_oled.clearBuffer();
  u8g2_oled.sendBuffer();
}

void oledClear() {
  u8g2_oled.clearBuffer();
}

void oledRefresh() {
  u8g2_oled.sendBuffer();
}

void oledDrawString(int x, int y, const char* str) {
  u8g2_oled.drawUTF8(x, y + 12, str);
}

void oledDrawBitmap(int x, int y, int w, int h, const uint8_t* bitmap) {
  u8g2_oled.drawXBM(x, y, w, h, bitmap);
}

void oledShowWelcome() {
  oledClear();
  oledDrawString(10, 0,  "Learning Game");
  oledDrawString(25, 18, "ESP32-S3");
  oledDrawString(10, 50, "Press Key");
  oledRefresh();
}

void oledShowFace(uint8_t faceType) {
  if (faceType >= FACE_COUNT) return;

  oledClear();

  if (borderTop[0]) {
    oledDrawString(40, 0, borderTop);
  }

  if (borderBottom[0]) {
    oledDrawString(40, 52, borderBottom);
  }

  const uint8_t* bmp = faceBitmaps[faceType];
  oledDrawBitmap(56, 24, 16, 16, bmp);

  oledRefresh();
}

void showFullImage(const uint8_t* src) {
  static uint8_t buf[1024];
  static const uint8_t* cachedSrc = NULL;
  if (cachedSrc != src) {
    for (int page = 0; page < 8; page++) {
      for (int col = 0; col < 128; col++) {
        uint8_t v = 0;
        for (int b = 0; b < 8; b++) {
          int py = page * 8 + b;
          int srcByte = py * 16 + (col >> 3);
          int srcBit  = 7 - (col & 7);
          if (pgm_read_byte(&src[srcByte]) & (1 << srcBit))
            v |= (1 << b);
        }
        buf[col + page * 128] = v ^ 0xFF;
      }
    }
    cachedSrc = src;
  }
  memcpy(u8g2_oled.getBufferPtr(), buf, 1024);
  u8g2_oled.sendBuffer();
}

void oledShowPhanion()   { showFullImage(image_phanion);  }
void oledShowPhanion2()  { showFullImage(image_phanion2); }
void oledShowPhanion3()  { showFullImage(image_phanion3); }
void oledShowMydei1()    { showFullImage(image_mydei1);   }
void oledShowMydei2()    { showFullImage(image_mydei2);   }
void oledShowMydei3()    { showFullImage(image_mydei3);   }
void oledShowConflict()  { showFullImage(image_conflict);  }

// ===== 动态表情包 (128x64 XBM, 来自 emoji_bitmaps.h) =====
uint8_t oledEmojiGroupCount() { return EMOJI_GROUP_COUNT; }

// 画某组的某一帧 (整屏)
static void drawEmojiFrame(uint8_t group, uint8_t frame) {
  if (group >= EMOJI_GROUP_COUNT) return;
  uint8_t frames = emojiGroupFrames[group];
  if (frame >= frames) frame = 0;
  const uint8_t* bmp = emojiGroups[group][frame];
  u8g2_oled.clearBuffer();
  u8g2_oled.drawXBM(0, 0, EMOJI_W, EMOJI_H, bmp);
  u8g2_oled.sendBuffer();
}

// 播放第 group 组动画: 按 interval 毫秒在分镜间循环(每次调用按 millis 自动选帧)
void oledPlayEmojiAnim(uint8_t group, uint32_t interval) {
  if (group >= EMOJI_GROUP_COUNT) return;
  uint8_t frames = emojiGroupFrames[group];
  if (frames == 0) return;
  uint8_t frame = (millis() / interval) % frames;
  static uint8_t lastGroup = 255, lastFrame = 255;
  if (group != lastGroup || frame != lastFrame) {   // 仅变化时刷新, 省I2C
    drawEmojiFrame(group, frame);
    lastGroup = group; lastFrame = frame;
  }
}

// 待机循环: 每 groupMs 切到下一组, 组内每 frameMs 切分镜
void oledPlayEmojiIdle(uint32_t frameMs, uint32_t groupMs) {
  uint8_t group = (millis() / groupMs) % EMOJI_GROUP_COUNT;
  oledPlayEmojiAnim(group, frameMs);
}


void oledShowBlinkingFace(uint8_t faceA, uint8_t faceB, uint32_t interval) {
  bool showA = (millis() / interval) % 2 == 0;
  oledShowFace(showA ? faceA : faceB);
}

void oledDrawBorderText(const char* top, const char* bottom) {
  if (top) {
    strncpy(borderTop, top, sizeof(borderTop) - 1);
    borderTop[sizeof(borderTop) - 1] = '\0';
  } else {
    borderTop[0] = '\0';
  }
  if (bottom) {
    strncpy(borderBottom, bottom, sizeof(borderBottom) - 1);
    borderBottom[sizeof(borderBottom) - 1] = '\0';
  } else {
    borderBottom[0] = '\0';
  }
}

void oledShowScore(int score) {
  oledClear();
  char buf[32];
  snprintf(buf, sizeof(buf), "Score: %d", score);
  oledDrawString(30, 25, buf);
  oledRefresh();
}

U8G2* getOLED() {
  return &u8g2_oled;
}
